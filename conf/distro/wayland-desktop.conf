## conf/distro/wayland-desktop.conf
```bitbake
DISTRO = "wayland-desktop"
DISTRO_NAME = "OpenEmbedded (wayland)"
DISTRO_FEATURES:append = " \
    acl \
    alsa \
    bluetooth \
    dbus \
    ext2 \
    gobject-introspection \
    gtk+3 \
    gtk4 \
    ipv4 \
    ipv6 \
    largefile \
    nfc \
    nfs \
    opengl \
    pam \
    pci \
    pcmcia \
    pipewire \
    polkit \
    pulseaudio \
    seccomp \
    security \
    systemd \
    tpm2 \
    usbgadget \
    usbhost \
    usrmerge \
    vfat \
    virtualization \
    vulkan \
    wayland \
    wifi \
    x11 \
    xattr \
    xwayland \
    zeroconf \
"

HOSTTOOLS += "inkscape java"

WKS_FILE:x86-64 ?= "${@bb.utils.contains('BUILD_APPLIANCE', '1', 'systemd-ext4.wks', 'systemd-btrfs.wks', d)}"
WKS_FILE:rpi ?= "sdimage-raspberrypi.wks"
IMAGE_FSTYPES = "wic wic.bmap tar.gz"

DISTRO_FEATURES_BACKFILL:remove = "pulseaudio ldconfig"
DISTRO_FEATURES_BACKFILL_CONSIDERED = "sysvinit"
DISTRO_FEATURES:remove = "sysvinit"

# Use systemd for system initialization
DISTRO_FEATURES_BACKFILL_CONSIDERED:append = " sysvinit"
VIRTUAL-RUNTIME_init_manager = "systemd"
VIRTUAL-RUNTIME_initscripts = "systemd-compat-units"
VIRTUAL-RUNTIME_login_manager = "shadow-base"
VIRTUAL-RUNTIME_dev_manager = "systemd"
KERNEL_FEATURES:append = " cfg/systemd.scc"

# Ensure the kernel nfs server is enabled
KERNEL_FEATURES:append = " features/nfsd/nfsd-enable.scc"

# Replace busybox
PREFERRED_PROVIDER_virtual/base-utils = "coreutils"
VIRTUAL-RUNTIME_base-utils = "coreutils"
VIRTUAL-RUNTIME_base-utils-hwclock = "util-linux-hwclock"
VIRTUAL-RUNTIME_base-utils-syslog = ""

# System configuration
PIPEWIRE_SESSION_MANAGER = "wireplumber"
WIRELESS_DAEMON = "iwd"

# Overrides for meta-raspberrypi
PREFERRED_PROVIDER_ffmpeg = "ffmpeg"
PREFERRED_PROVIDER_libav = "ffmpeg"
PREFERRED_PROVIDER_libpostproc = "ffmpeg"
LICENSE_FLAGS_ACCEPTED:append:rpi = " synaptics-killswitch"

# let llvm be provided by clang
PREFERRED_PROVIDER_llvm = "clang"
PREFERRED_PROVIDER_llvm-native = "clang-native"
PREFERRED_PROVIDER_lld = "clang"
PREFERRED_PROVIDER_lld-native = "clang"
PREFERRED_PROVIDER_nativesdk-llvm = "nativesdk-clang"
PROVIDES:pn-clang = "llvm"
PROVIDES:pn-clang-native = "llvm-native"
PROVIDES:pn-nativesdk-clang = "nativesdk-llvm"
```

## conf/layer.conf
```bitbake
# We have a conf and classes directory, add to BBPATH
BBPATH .= ":${LAYERDIR}"

# We have recipes-* directories, add to BBFILES
BBFILES += "${LAYERDIR}/recipes-*/*/*.bb ${LAYERDIR}/recipes-*/*/*.bbappend"

BBFILE_COLLECTIONS += "image"
BBFILE_PATTERN_image = "^${LAYERDIR}/"
BBFILE_PRIORITY_image = "5"

# This should only be incremented on significant changes that will
# cause compatibility issues with other layers
LAYERVERSION_image = "1"
LAYERSERIES_COMPAT_image = "nanbield scarthgap"
LAYERDEPENDS_image = "core openembedded-layer"
```

## wic/sdimage-raspberrypi.wks
```
# short-description: Create Raspberry Pi SD card image
# long-description: Creates a partitioned SD card image for use with
# Raspberry Pi. Boot files are located in the first vfat partition.

part /boot --source bootimg-partition --ondisk mmcblk0 --fstype=vfat --label boot --active --align 4096 --size 20
part / --source rootfs --ondisk mmcblk0 --fstype=btrfs --label root --align 4096
part /home --source rootfs --rootfs-dir=${IMAGE_ROOTFS}/home --ondisk mmcblk0 --fstype=btrfs  --size 200 --label home --use-uuid
```
